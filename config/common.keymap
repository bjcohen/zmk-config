#include <dt-bindings/zmk/hid_usage_pages.h>

#include "zmk-helpers/helper.h"

#define GALLIUM 0
#define QWERTY 1
#define LOWER 2
#define RAISE 3
#define ADJUST 4

#define MCTL (ZMK_HID_USAGE(HID_USAGE_CONSUMER, 0xc1))
#define SPOT (ZMK_HID_USAGE(HID_USAGE_CONSUMER, 0x221))
#define DICT (ZMK_HID_USAGE(HID_USAGE_CONSUMER, 0xcf))
#define DND (ZMK_HID_USAGE(HID_USAGE_CONSUMER, 0x9b))

ZMK_HOLD_TAP(hml,
    flavor = "balanced";
    tapping-term-ms = <280>;
    quick-tap-ms = <175>;                // repeat on tap-into-hold
    require-prior-idle-ms = <150>;
    bindings = <&kp>, <&kp>;
    hold-trigger-key-positions = <KEYS_R THUMBS>;
    hold-trigger-on-release;             // delay positional check until key-release
)

ZMK_HOLD_TAP(hmr,
    flavor = "balanced";
    tapping-term-ms = <280>;
    quick-tap-ms = <175>;                // repeat on tap-into-hold
    require-prior-idle-ms = <150>;
    bindings = <&kp>, <&kp>;
    hold-trigger-key-positions = <KEYS_L THUMBS>;
    hold-trigger-on-release;             // delay positional check until key-release
)

#define MO_TOG(layer) &mo_tog layer layer
#define SC(mod) &shift_caps mod mod

/ {
    behaviors {
        mo_tog: behavior_mo_tog {
            compatible = "zmk,behavior-hold-tap";
            #binding-cells = <2>;
            flavor = "hold-preferred";
            tapping-term-ms = <200>;
            bindings = <&mo>, <&tog>;
        };

        shift_caps: behavior_shift_caps {
            compatible = "zmk,behavior-hold-tap";
            #binding-cells = <2>;
            flavor = "hold-preferred";
            tapping-term-ms = <200>;
            bindings = <&kp>, <&caps_word>;
        };
    };
};

&caps_word {
    continue-list = <UNDERSCORE MINUS BACKSPACE DELETE>;
};

/ {

    conditional_layers {
        compatible = "zmk,conditional-layers";
        adjust_layer {
            if-layers = <LOWER RAISE>;
            then-layer = <ADJUST>;
        };
    };

    behaviors {
        tog_on: toggle_layer_on_only {
            compatible = "zmk,behavior-toggle-layer";
            #binding-cells = <1>;
            display-name = "Toggle Layer On";
            toggle-mode = "on";
        };


        tog_off: toggle_layer_off_only {
            compatible = "zmk,behavior-toggle-layer";
            #binding-cells = <1>;
            display-name = "Toggle Layer Off";
            toggle-mode = "off";
        };
    };

    layer_listeners {
        compatible = "zmk,layer-listeners";

        lower_red {
            layers = <LOWER>;
            bindings = <&rgb_ug RGB_COLOR_HSB(0,100,100) &rgb_ug RGB_COLOR_HSB(240,100,100)>;
        };

        raise_green {
            layers = <RAISE>;
            bindings = <&rgb_ug RGB_COLOR_HSB(120,100,100) &rgb_ug RGB_COLOR_HSB(240,100,100)>;
        };

        adjust_white {
            layers = <ADJUST>;
            bindings = <&rgb_ug RGB_COLOR_HSB(0,0,100) &rgb_ug RGB_COLOR_HSB(240,100,100)>;
        };
    };

    keymap {
        compatible = "zmk,keymap";

        gallium_layer {
            display-name = "gallium";
            bindings = <
EXTRA_ROW_GALLIUM
&kp TAB   &kp B        &kp L       &kp D       &kp C        &kp V                          &kp J     &kp Y        &kp O       &kp U       &kp COMMA    &kp BSPC
&kp ESC   &hml LCTRL N &hml LALT R &hml LGUI T &hml LSHFT S &kp G                          &kp P     &hmr RSHFT H &hmr RGUI A &hmr LALT E &hmr RCTRL I &kp FSLH
SC(LSHFT) &kp X        &kp Q       &kp M       &kp W        &kp Z   ENCODER_L ENCODER_R    &kp K     &kp F        &kp SQT     &kp SEMI    &kp DOT      SC(RSHFT)
THUMB_BASE
            >;
            SENSOR_BINDINGS
        };

        qwerty_layer {
            display-name = "qwerty";
            bindings = <
EXTRA_ROW_QWERTY
&kp TAB   &kp Q        &kp W       &kp E       &kp R        &kp T                          &kp Y     &kp U        &kp I       &kp O       &kp P           &kp BSPC
&kp ESC   &hml LCTRL A &hml LALT S &hml LGUI D &hml LSHFT F &kp G                          &kp H     &hmr RSHFT J &hmr RGUI K &hmr LALT L &hmr RCTRL SEMI &kp SQT
SC(LSHFT) &kp Z        &kp X       &kp C       &kp V        &kp B   ENCODER_L ENCODER_R    &kp N     &kp M        &kp COMMA   &kp DOT     &kp FSLH        SC(RSHFT)
THUMB_BASE
            >;
            SENSOR_BINDINGS
        };

        lower_layer {
            display-name = "lower";
            bindings = <
EXTRA_ROW_LOWER
&kp GRAVE &kp CARET       &kp AMPS     &kp ASTRK      &kp LPAR        &kp RPAR                       &kp LT   &kp N7        &kp N8       &kp N9       &kp LBKT        &kp RBKT
&kp COLON &hml LCTRL EXCL &hml LALT AT &hml LGUI HASH &hml LSHFT DLLR &kp PRCNT                      &kp PLUS &hmr RSHFT N4 &hmr RGUI N5 &hmr LALT N6 &hmr RCTRL LBRC &kp RBRC
&kp SEMI  &kp EQUAL       &kp MINUS    &kp PIPE       &kp GT          &kp TILDE ENCODER_L ENCODER_R  &kp N0   &kp N1        &kp N2       &kp N3       &kp BSLH        &trans
THUMB_TRANS
            >;
            SENSOR_BINDINGS
        };

        raise_layer {
            display-name = "raise";
            bindings = <
EXTRA_ROW_RAISE
&trans &kp F7        &kp F8       &kp F9       &kp F10        &trans                             &kp K_REDO &kp K_PASTE     &kp K_COPY   &kp K_CUT       &kp K_UNDO     &trans
&trans &hml LCTRL F4 &hml LALT F5 &hml LGUI F6 &hml LSHFT F11 &caps_word                         &kp LEFT   &hmr RSHFT DOWN &hmr RGUI UP &hmr LALT RIGHT &hmr RCTRL DEL &kp BSPC
&trans &kp F1        &kp F2       &kp F3       &kp F12        &trans      ENCODER_L ENCODER_R    &kp HOME   &kp PG_DN       &kp PG_UP    &kp END         &kp D          &trans
THUMB_TRANS
            >;
            SENSOR_BINDINGS
        };

        adjust_layer {
            display-name = "adjust";
            bindings = <
EXTRA_ROW_ADJUST
&bt BT_CLR        &bt BT_SEL 0    &bt BT_SEL 1     &bt BT_SEL 2    &bt BT_SEL 3    &bt BT_SEL 4                            &kp C_BRI_DN &kp C_BRI_UP &kp MCTL     &kp SPOT     &kp DICT &kp DND
&ext_power EP_TOG &rgb_ug RGB_HUD &rgb_ug RGB_HUI  &rgb_ug RGB_SAD &rgb_ug RGB_SAI &rgb_ug RGB_EFF                         &none        &kp K_VOL_DN &kp K_MUTE   &kp K_VOL_UP &none    &none
&rgb_ug RGB_BRD   &rgb_ug RGB_BRI &tog_on QWERTY   &tog_off QWERTY &none           &rgb_ug RGB_TOG ENCODER_L ENCODER_R     &none        &kp C_PREV   &kp C_PP     &kp C_NEXT   &none    &none
THUMB_TRANS
            >;
            SENSOR_BINDINGS
        };
    };
};

