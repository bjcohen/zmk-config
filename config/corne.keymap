#include <behaviors.dtsi>
#include <dt-bindings/zmk/keys.h>
#include <dt-bindings/zmk/bt.h>
#include <dt-bindings/zmk/rgb.h>
#include <dt-bindings/zmk/ext_power.h>

#include "zmk-helpers/key-labels/42.h"

#define KEYS_L LT0 LT1 LT2 LT3 LT4 LT5 LM0 LM1 LM2 LM3 LM4 LM5 LB0 LB1 LB2 LB3 LB4 LB5
#define KEYS_R RT0 RT1 RT2 RT3 RT4 RT5 RM0 RM1 RM2 RM3 RM4 RM5 RB0 RB1 RB2 RB3 RB4 RB5
#define THUMBS LH2 LH1 LH0 RH0 RH1 RH2

// Layout wrapper macros for Corne (42-key)
// No extra number row
#define EXTRA_ROW_GALLIUM
#define EXTRA_ROW_QWERTY
#define EXTRA_ROW_LOWER
#define EXTRA_ROW_RAISE
#define EXTRA_ROW_ADJUST

// No encoder column
#define ENCODER_L
#define ENCODER_R

// Thumb clusters (3 keys per side)
#define THUMB_BASE     &kp LGUI MO_TOG(LOWER) &kp RET   &kp SPACE MO_TOG(RAISE) &kp RALT
#define THUMB_TRANS    &trans &trans &trans             &trans &trans &trans

// No rotary encoders
#define SENSOR_BINDINGS

#include "common.keymap"

&led_strip {
    chain-length = <27>;
};
