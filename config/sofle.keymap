/*
 * Copyright (c) 2020 The ZMK Contributors
 *
 * SPDX-License-Identifier: MIT
 */

#include <behaviors.dtsi>
#include <dt-bindings/zmk/bt.h>
#include <dt-bindings/zmk/ext_power.h>
#include <dt-bindings/zmk/keys.h>
#include <dt-bindings/zmk/rgb.h>
#include <input/processors.dtsi>

#include "zmk-helpers/key-labels/sofle.h"

#define KEYS_L LN0 LN1 LN2 LN3 LN4 LN5 LT0 LT1 LT2 LT3 LT4 LT5 LM0 LM1 LM2 LM3 LM4 LM5 LB0 LB1 LB2 LB3 LB4 LB5
#define KEYS_R RN0 RN1 RN2 RN3 RN4 RN5 RT0 RT1 RT2 RT3 RT4 RT5 RM0 RM1 RM2 RM3 RM4 RM5 RB0 RB1 RB2 RB3 RB4 RB5
#define THUMBS LH4 LH3 LH2 LH1 LH0 RH0 RH1 RH2 RH3 RH4

// Layout wrapper macros for Sofle (58-key)
// Extra number row
#define EXTRA_ROW_GALLIUM  &kp GRAVE &kp N1 &kp N2 &kp N3 &kp N4 &kp N5   &kp N6 &kp N7 &kp N8 &kp N9 &kp N0 &kp MINUS
#define EXTRA_ROW_QWERTY   &kp GRAVE &kp N1 &kp N2 &kp N3 &kp N4 &kp N5   &kp N6 &kp N7 &kp N8 &kp N9 &kp N0 &kp MINUS
#define EXTRA_ROW_LOWER    &trans &trans &trans &trans &trans &trans      &trans &trans &trans &trans &trans &trans
#define EXTRA_ROW_RAISE    &trans &trans &trans &trans &trans &trans      &trans &trans &trans &trans &trans &trans
#define EXTRA_ROW_ADJUST   &none &none &none &none &none &none            &none &none &none &none &none &none

// Encoder column in bottom row
// - ENCODER_L/R: key binding when encoder is pressed (tap)
// - SENSOR_BINDINGS: rotation behavior (left encoder: volume, right encoder: page scroll)
#define ENCODER_L  &kp C_MUTE
#define ENCODER_R  &none
#define SENSOR_BINDINGS  sensor-bindings = <&inc_dec_kp C_VOL_UP C_VOL_DN &inc_dec_kp PG_UP PG_DN>;

// Thumb clusters (5 keys per side)
// Intentionally different from Corne: Sofle uses Ctrl/Alt on outer thumbs since the extra
// keys allow dedicated modifier positions. Corne uses GUI on outer thumb due to fewer keys.
// Duplicate RET/SPACE keys provide a larger "landing zone" for the most-used thumb keys,
// reducing the need for precise finger placement.
#define THUMB_BASE   &kp LCTRL &kp LALT &mo LOWER &kp RET MO_TOG(LOWER)   MO_TOG(RAISE) &kp SPACE &mo RAISE &kp RALT &kp RCTRL
#define THUMB_TRANS  &trans &trans &trans &trans &trans                   &trans &trans &trans &trans &trans

#include "common.keymap"

&glidepoint_listener {
    input-processors = <&zip_xy_scaler 3 2>;

    scroller {
        layers = <LOWER>;
        input-processors = <&zip_xy_to_scroll_mapper &zip_scroll_scaler 1 10>;
    };
};
