#include <dt-bindings/zmk/input_transform.h>
#include <input/processors.dtsi>

#include "sofle.dtsi"

&i2c0 {
    status = "okay";
    glidepoint0: glidepoint@2a {
        status = "okay";
    };
};

&glidepoint_split {
    device = <&glidepoint0>;

    input-processors = <&zip_xy_transform (INPUT_TRANSFORM_Y_INVERT)>;
};
